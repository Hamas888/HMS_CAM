## Kconfig
```kconfig
menu "HMS CAM Configuration"

    config HMS_CAM_ENABLED
        bool "Enable HMS CAM Component"
        default y
        help
          Enable support for the HMS CAM camera module.

if HMS_CAM_ENABLED
    config HMS_CAM_PWDN_GPIO
        int "PWDN GPIO"
        default -1

    config HMS_CAM_RESET_GPIO
        int "RESET GPIO"
        default -1

    config HMS_CAM_XCLK_GPIO
        int "XCLK GPIO"
        default 15

    config HMS_CAM_SIOD_GPIO
        int "SIOD GPIO"
        default 4

    config HMS_CAM_SIOC_GPIO
        int "SIOC GPIO"
        default 5
    config HMS_CAM_Y9_GPIO
        int "Y9 GPIO"
        default 16
    config HMS_CAM_Y8_GPIO
        int "Y8 GPIO"
        default 17
    config HMS_CAM_Y7_GPIO
        int "Y7 GPIO"
        default 18
    config HMS_CAM_Y6_GPIO
        int "Y6 GPIO"
        default 12
    config HMS_CAM_Y5_GPIO
        int "Y5 GPIO"
        default 10
    config HMS_CAM_Y4_GPIO
        int "Y4 GPIO"
        default 8
    config HMS_CAM_Y3_GPIO
        int "Y3 GPIO"
        default 9
    config HMS_CAM_Y2_GPIO
        int "Y2 GPIO"
        default 11
    config HMS_CAM_VSYNC_GPIO
        int "VSYNC GPIO"
        default 6
    config HMS_CAM_HREF_GPIO
        int "HREF GPIO"
        default 7
    config HMS_CAM_PCLK_GPIO
        int "PCLK GPIO"
        default 13
    config HMS_CAM_LED_GPIO
        int "LED GPIO"
        default 21

    config HMS_CAM_DEBUG
        bool "Enable HMS CAM Debug Logging"
        default n
        help
          Enable detailed debug messages for the camera component.
          Requires ChronoLog to be present.

    config HMS_CAM_LOG_LEVEL
        int "HMS CAM Log Level"
        range 0 4
        default 3
        depends on HMS_CAM_DEBUG
        help
          0: Error, 1: Warn, 2: Info, 3: Debug, 4: Verbose
endif # HMS_CAM_ENABLED

endmenu # HMS CAM Configuration
```
